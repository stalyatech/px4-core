## src/drivers/freq_input/Kconfig
```kconfig
menuconfig DRIVERS_FREQ_INPUT
	bool "freq_input"
	default n
	---help---
		Enable support for freq_input
```

## src/drivers/imu/invensense/icm20689x/Kconfig
```kconfig
menuconfig DRIVERS_IMU_INVENSENSE_ICM20689X
	bool "icm20689x"
	default n
	---help---
		Enable support for icm20689 extended
```

## src/drivers/imu/stalya/bmi088/Kconfig
```kconfig
menuconfig DRIVERS_IMU_STALYA_BMI088
	bool "bmi088"
	default n
	---help---
		Enable support for custom bmi088
```

## src/drivers/imu/stalya/icm20689x/Kconfig
```kconfig
menuconfig DRIVERS_IMU_STALYA_ICM20689X
	bool "icm20689x"
	default n
	---help---
		Enable support for icm20689 extended
```

## src/drivers/pca9557/Kconfig
```kconfig
menuconfig DRIVERS_PCA9557
	bool "pca9557"
	default n
	---help---
		Enable support for pca9557
```

## src/drivers/tattu_can/Kconfig
```kconfig
menuconfig DRIVERS_TATTUCAN
	bool "tattucan"
	default n
	---help---
		Enable support for Tattu Battery CAN bus
```

## src/drivers/tattu_socketcan/Kconfig
```kconfig
menuconfig DRIVERS_TATTU_SOCKETCAN
	bool "tattu_socketcan"
	default n
	---help---
		Enable support for tattu_socketcan
```

## src/drivers/usbhub/usb2514/Kconfig
```kconfig
menuconfig DRIVERS_USBHUB_USB2514
	bool "usb2514"
	default y
	---help---
		Enable support for usb2514
```

## src/drivers/usbhub/usb2517/Kconfig
```kconfig
menuconfig DRIVERS_USBHUB_USB2517
	bool "usb2517"
	default n
	---help---
		Enable support for usb2517
```

## src/examples/fake_flow/Kconfig
```kconfig
menuconfig EXAMPLES_FAKE_FLOW
	bool "fake_flow"
	default n
	---help---
		Enable support for fake flowmeter.
```

## src/modules/spray/Kconfig
```kconfig
menuconfig MODULES_SPRAY
	bool "spray"
	default n
	---help---
		Enable support for smart spray module.
```

## src/modules/tank_level/Kconfig
```kconfig
menuconfig MODULES_TANK_LEVEL
	bool "tank_level"
	default n
	---help---
		Enable support for tank level estimator
```
