## boards/stalya/nexus-v1/Kconfig
```kconfig
menu "simpleTRAP FMU (nexus-v1)"

choice
	prompt "FMU hardware revision"
	default BOARD_FMU_REV02
	---help---
		MCU pin assignment of the simpleTRAP FMU board. Select the
		revision printed on the board.

config BOARD_FMU_REV01
	bool "Rev01"
	---help---
		I/O expander reset on PE14, ICM-20689 chip select on PA4,
		buzzer on PE15 (on/off only), no hardware revision divider.

config BOARD_FMU_REV02
	bool "Rev02"
	---help---
		I/O expander reset on PE15, ICM-20689 chip select on PE14,
		buzzer on PB3 (TIM2_CH2), hardware revision divider on PA4.

endchoice

config BOARD_TPU_TELEM4_SWAP
	bool "Swap TELEM4 TX/RX for the TPU Linux link"
	default n
	---help---
		On the NexusV1-TPU the Linux UART2 RX sits on IOP1 pin 23, the
		FMU UART4 RX line, and the Linux UART2 TX reaches IOP1 pin 22,
		the FMU UART4 TX line, only through a bridge between U13 pins 1
		and 3. With that bridge fitted, enable this to swap UART4 TX and
		RX at boot so TELEM4 talks to the TPU Linux side. Leave it off
		when TELEM4 drives the XBEE2 socket.

endmenu
```

## boards/stalya/nexus-v2/nuttx-config/nsh/defconfig
```kconfig
#
CONFIG_ARCH="risc-v"
CONFIG_ARCH_BOARD_CUSTOM=y
CONFIG_ARCH_BOARD_CUSTOM_DIR="../../../../boards/stalya/nexus-v2/nuttx-config"
CONFIG_ARCH_BOARD_CUSTOM_DIR_RELPATH=y
CONFIG_ARCH_BOARD_CUSTOM_NAME="nexus nexus-v2"
CONFIG_ARCH_CHIP="sapphire"
CONFIG_ARCH_CHIP_SAPPHIRE=y
CONFIG_ARCH_CHIP_SAPPHIRE_SOCX3=y
CONFIG_ARCH_DPFPU=y
CONFIG_ARCH_FPU=y
CONFIG_ARCH_HAVE_DEBUG=y
CONFIG_ARCH_INTERRUPTSTACK=8192
CONFIG_ARCH_LAZYFPU=y
CONFIG_ARCH_RISCV=y
CONFIG_ARCH_SIZET_LONG=y
CONFIG_ARCH_STACKDUMP=y
# CONFIG_ASSERTIONS_FILENAME is not set
CONFIG_BINFMT_DISABLE=y
CONFIG_BOARDCTL_RESET=y
CONFIG_BOARD_LOOPSPERMSEC=10000
CONFIG_BOOT_RUNFROMEXTSRAM=y
CONFIG_BUILTIN=y
CONFIG_DEBUG_ASSERTIONS=y
CONFIG_DEBUG_ERROR=y
CONFIG_DEBUG_FEATURES=y
# CONFIG_DEBUG_OPT_UNUSED_SECTIONS is not set
CONFIG_DEBUG_RPMSG=y
CONFIG_DEBUG_RPMSG_ERROR=y
CONFIG_DEBUG_RPMSG_INFO=y
CONFIG_DEBUG_RPMSG_WARN=y
CONFIG_DEBUG_SYMBOLS=y
CONFIG_DEBUG_WARN=y
CONFIG_DEV_CONSOLE=y
CONFIG_DEV_URANDOM=y
CONFIG_DISABLE_MQUEUE_NOTIFICATION=y
# CONFIG_DISABLE_OS_API is not set
CONFIG_ENABLE_ALL_SIGNALS=y
CONFIG_ETC_ROMFS=y
CONFIG_FILE_STREAM=y
CONFIG_FRAME_POINTER=y
# CONFIG_FS_ANONMAP is not set
CONFIG_FS_BINFS=y
CONFIG_FS_NAMED_SEMAPHORES=y
CONFIG_FS_PROCFS=y
CONFIG_FS_PROCFS_REGISTER=y
CONFIG_FS_ROMFS=y
CONFIG_FS_ROMFS_WRITEABLE=y
CONFIG_FS_SHMFS=y
CONFIG_FS_TMPFS=y
CONFIG_GRAN=y
CONFIG_GRAN_INTR=y
CONFIG_HAVE_CXX=y
CONFIG_HAVE_CXXINITIALIZE=y
CONFIG_I2C=y
CONFIG_I2C_DRIVER=y
CONFIG_IDLETHREAD_STACKSIZE=8192
CONFIG_INIT_ENTRYPOINT="nsh_main"
CONFIG_INIT_STACKSIZE=8192
CONFIG_IOB_BUFSIZE=256
CONFIG_IOB_NBUFFERS=32
CONFIG_LIBC_ENVPATH=y
CONFIG_LIBC_FLOATINGPOINT=y
CONFIG_LIBC_HOSTNAME="nexus"
# CONFIG_LIBC_INLINE_QUEUE is not set
CONFIG_LIBC_LONG_LONG=y
CONFIG_LIBC_MEMFD_ERROR=y
CONFIG_LIBC_PERROR_STDOUT=y
CONFIG_LIBC_STRERROR=y
CONFIG_LIBC_STRSIGNAL_SHORT=y
# CONFIG_LIBC_TEMPBUFFER is not set
CONFIG_LIBM_TOOLCHAIN=y
CONFIG_LINE_MAX=128
CONFIG_MM_DEFAULT_ALIGNMENT=8
CONFIG_MM_REGIONS=1
# CONFIG_NDEBUG is not set
CONFIG_NO_SERIAL_CONSOLE=y
# CONFIG_NSH_ALIAS is not set
CONFIG_NSH_ARCHINIT=y
CONFIG_NSH_ARGCAT=y
CONFIG_NSH_BUILTIN_APPS=y
# CONFIG_NSH_DISABLE_DATE is not set
CONFIG_NSH_DISABLE_IFCONFIG=y
CONFIG_NSH_DISABLE_IFUPDOWN=y
# CONFIG_NSH_DISABLE_MB is not set
# CONFIG_NSH_DISABLE_MH is not set
# CONFIG_NSH_DISABLE_MW is not set
CONFIG_NSH_DISABLE_PSSIGMASK=y
CONFIG_NSH_FILEIOSIZE=64
CONFIG_NSH_MAXARGUMENTS=15
CONFIG_NSH_NESTDEPTH=8
CONFIG_NSH_PROMPT_MAX=64
CONFIG_NSH_QUOTE=y
CONFIG_NSH_STRERROR=y
CONFIG_NSH_VARS=y
CONFIG_PID_INITIAL_COUNT=8
CONFIG_PIPES=y
CONFIG_POSIX_SPAWN_DEFAULT_STACKSIZE=8192
CONFIG_PREALLOC_MQ_IRQ_MSGS=4
CONFIG_PREALLOC_MQ_MSGS=4
CONFIG_PREALLOC_TIMERS=8
CONFIG_PSEUDOFS_ATTRIBUTES=y
CONFIG_PSEUDOFS_FILE=y
CONFIG_PSEUDOFS_SOFTLINKS=y
CONFIG_PTHREAD_ATFORK=y
CONFIG_PTHREAD_MUTEX_TYPES=y
CONFIG_PTHREAD_SPINLOCKS=y
CONFIG_PTHREAD_STACK_DEFAULT=8192
CONFIG_RAM_SIZE=23003136
CONFIG_RAM_START=0x1e800000
CONFIG_RAW_BINARY=y
CONFIG_READLINE_CMD_HISTORY=y
CONFIG_READLINE_TABCOMPLETION=y
CONFIG_RISCV_PERCPU_SCRATCH=y
CONFIG_RISCV_STRING_FUNCTION=y
CONFIG_RPMSG_LOCAL_CPUNAME="fcu"
CONFIG_RPMSG_UART_RAW=y
CONFIG_RPTUN=y
CONFIG_RR_INTERVAL=200
CONFIG_SAPPHIRE_GPIO0=y
CONFIG_SAPPHIRE_GPIO0_IRQ=y
CONFIG_SAPPHIRE_I2C0=y
CONFIG_SAPPHIRE_RAMCON=y
CONFIG_SAPPHIRE_RAMCON_BASE=0x1fdf0000
CONFIG_SAPPHIRE_RPTUN=y
CONFIG_SAPPHIRE_RPTUN_CPUNAME="linux"
CONFIG_SAPPHIRE_RPTUN_IRQ=48
CONFIG_SAPPHIRE_SYS_CORE_FREQ_HZ=200000000
CONFIG_SAPPHIRE_TIMER0=y
CONFIG_SAPPHIRE_UART1=y
CONFIG_SAPPHIRE_UART2=y
CONFIG_SCHED_HPWORK=y
CONFIG_SCHED_INSTRUMENTATION=y
CONFIG_SCHED_INSTRUMENTATION_SWITCH=y
CONFIG_SCHED_LPWORK=y
CONFIG_SCHED_WAITPID=y
CONFIG_SERIAL_TERMIOS=y
CONFIG_SIG_DEFAULT=y
CONFIG_SIG_EVTHREAD=y
CONFIG_SIG_EVTHREAD_HPWORK=y
CONFIG_SIG_PREALLOC_IRQ_ACTIONS=4
CONFIG_SIG_SIGALRM_ACTION=y
CONFIG_SIG_SIGPIPE_ACTION=y
CONFIG_SIG_SIGPROF_ACTION=y
CONFIG_SIG_SIGUSR1_ACTION=y
CONFIG_SIG_SIGUSR2_ACTION=y
CONFIG_STACK_COLORATION=y
CONFIG_START_YEAR=2026
# CONFIG_SYSTEM_DD is not set
CONFIG_SYSTEM_I2CTOOL=y
CONFIG_SYSTEM_NSH=y
CONFIG_TASK_NAME_SIZE=24
# This file is autogenerated: PLEASE DO NOT EDIT IT.
# You can then do "make savedefconfig" to generate a new defconfig file that includes your
# You can use "make menuconfig" to make any modifications to the installed .config file.
# modifications.
```

## src/drivers/distance_sensor/mr72/Kconfig
```kconfig
menuconfig DRIVERS_DISTANCE_SENSOR_MR72
	bool "mr72"
	default n
	---help---
		Enable support for the Nanoradar MR72 radar

if DRIVERS_DISTANCE_SENSOR_MR72

choice
	prompt "MR72 interface"
	default MR72_IFACE_UART
	---help---
		The MR72 comes as a UART or a CAN model; select the one fitted.

config MR72_IFACE_UART
	bool "UART"
	---help---
		UART model, 115200 baud. Reports the nearest target of three
		sectors. Port set with SENS_MR72_CFG.

config MR72_IFACE_CAN
	bool "CAN"
	---help---
		CAN model, 500 kbit/s classic CAN through SocketCAN. Reports the
		full object list (distance, lateral offset, velocity, RCS). Port
		set with SENS_MR72_CAN, radar SensorID with SENS_MR72_ID.

endchoice

endif
```

## src/drivers/distance_sensor/nra15/Kconfig
```kconfig
menuconfig DRIVERS_DISTANCE_SENSOR_NRA15
	bool "nra15"
	default n
	---help---
		Enable support for NRA15 Radar

if DRIVERS_DISTANCE_SENSOR_NRA15

choice
	prompt "NRA15 interface"
	default NRA15_IFACE_UART
	---help---
		The NRA15 comes as a UART or a CAN model; select the one fitted.

config NRA15_IFACE_UART
	bool "UART"
	---help---
		UART model, 115200 baud. Port set with SENS_NRA15_CFG.

config NRA15_IFACE_CAN
	bool "CAN"
	---help---
		CAN model, 500 kbit/s classic CAN through SocketCAN. Port set
		with SENS_NRA15_CAN.

endchoice

endif
```

## src/drivers/secure_element/se050/Kconfig
```kconfig
menuconfig DRIVERS_SECURE_ELEMENT_SE050
	bool "se050 (NXP EdgeLock)"
	default n
	---help---
		NXP SE050 secure element over I2C.

		Provides a PX4 module 'se050' with 'start|stop|status'
		subcommands. 'se050 start' registers the NuttX /dev/se05x
		character device on the configured I2C bus.

		Must be started AFTER any slow (100 kHz-only) devices on the
		same bus have finished their one-shot init, because SE050 uses
		a per-transfer 400 kHz clock override.

		Requires NuttX defconfig options (not auto-selectable from the
		PX4 Kconfig tree):
		    CONFIG_CRYPTO=y
		    CONFIG_DEV_SE05X=y
		    CONFIG_DEV_SE05X_PLAIN=y  (or CONFIG_DEV_SE05X_SCP03=y)

		When disabled the module is not built and callers must fall
		back to a traditional software-based flow.
```

## src/examples/fake_mr72/Kconfig
```kconfig
menuconfig EXAMPLES_FAKE_MR72
	bool "fake_mr72"
	default n
	---help---
		Simulated MR72 radar for the tilt rig (needs rig_pose)
```

## src/examples/fake_nra15/Kconfig
```kconfig
menuconfig EXAMPLES_FAKE_NRA15
	bool "fake_nra15"
	default n
	---help---
		Simulated NRA15 altimeter for the tilt rig (needs rig_pose)
```

## src/modules/radar_imu_fusion/Kconfig
```kconfig
menuconfig MODULES_RADAR_IMU_FUSION
	bool "radar_imu_fusion"
	default n
	depends on MODULES_RIG_POSE
	---help---
		Tilt rig EKF: tilt, axis height and ground echo rejection
```

## src/modules/rig_pose/Kconfig
```kconfig
menuconfig MODULES_RIG_POSE
	bool "rig_pose"
	default n
	---help---
		Tilt rig platform angle to radar pose converter
```

## src/modules/tilt_rig/Kconfig
```kconfig
menuconfig MODULES_TILT_RIG
	bool "tilt_rig"
	default n
	---help---
		Tilt profiles for the radar/IMU rig through the gimbal manager (MAV_CMD_USER_1)
```

## src/systemcmds/serial_swap/Kconfig
```kconfig
menuconfig SYSTEMCMDS_SERIAL_SWAP
	bool "serial_swap"
	default n
	depends on PLATFORM_NUTTX
	---help---
		Swap or restore the TX and RX pins of a serial port (TIOCSSWAP)
```
